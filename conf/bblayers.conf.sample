## conf/local.conf
```bitbake
# PageSpeak Yocto Build Configuration
# ====================================
# This file is copied into the build directory by setup-build.sh.
# Edit this file (not the copy in build/conf/) for persistent changes.
#
# MULTI-TARGET SUPPORT
# --------------------
# PageSpeak supports Raspberry Pi 3, 4, and 5. MACHINE can be overridden:
#   - Via environment: MACHINE=raspberrypi4 bitbake pagespeak-image
#   - Via build script: ./build.sh rpi4
#   - By editing this file directly
#
# Available machines:
#   raspberrypi3    - RPi 3B/3B+ (32-bit ARM, kernel 5.15)
#   raspberrypi4    - RPi 4B (32-bit ARM, kernel 5.15)
#   raspberrypi4-64 - RPi 4B (64-bit ARM, kernel 5.15)
#   raspberrypi5    - RPi 5 (64-bit ARM, kernel 6.1)

# --- Machine Selection ---
# Default machine (can be overridden by environment variable)
MACHINE ?= "raspberrypi5"

# --- Distribution ---
DISTRO = "poky"

# --- Init System ---
INIT_MANAGER = "systemd"

# --- Package format ---
PACKAGE_CLASSES = "package_rpm"

# --- Raspberry Pi specific settings ---
# Enable UART serial console (required for RPi 3+ headless debugging)
ENABLE_UART = "1"

# GPU memory split — 128MB for camera/video use
GPU_MEM = "128"

# Enable V4L2 camera support in meta-raspberrypi
VIDEO_CAMERA = "1"

# --- Image output format ---
# rpi-sdimg produces a flashable SD card image
IMAGE_FSTYPES:append = " rpi-sdimg"

# --- Development features ---
# debug-tweaks: root login without password
EXTRA_IMAGE_FEATURES += "debug-tweaks"

# --- Build directories ---
# For Docker/container builds, use absolute paths to volumes mounted from
# the host to persist downloads and sstate cache, and to provide a
# case-sensitive filesystem for TMPDIR (required by Yocto, macOS HFS+ is not).
#
# For native Linux builds, comment these out — defaults are fine.
#DL_DIR = "/yocto-cache/downloads"
#SSTATE_DIR = "/yocto-cache/sstate-cache"
#TMPDIR = "/yocto-cache/tmp"

# --- Parallel build settings ---
BB_NUMBER_THREADS = "8"
PARALLEL_MAKE = "-j 8"

# --- License handling ---
LICENSE_FLAGS_ACCEPTED = "commercial"
```

## meta-pagespeak/conf/layer.conf
```bitbake
# Layer configuration for meta-pagespeak
# PageSpeak: portable OCR-to-speech device for visually impaired users

BBPATH .= ":${LAYERDIR}"

BBFILES += " \
    ${LAYERDIR}/recipes-*/*/*.bb \
    ${LAYERDIR}/recipes-*/*/*.bbappend \
"

BBFILE_COLLECTIONS += "meta-pagespeak"
BBFILE_PATTERN_meta-pagespeak = "^${LAYERDIR}/"
BBFILE_PRIORITY_meta-pagespeak = "10"

LAYERDEPENDS_meta-pagespeak = "core raspberrypi openembedded-layer multimedia-layer"
LAYERSERIES_COMPAT_meta-pagespeak = "kirkstone"
```
